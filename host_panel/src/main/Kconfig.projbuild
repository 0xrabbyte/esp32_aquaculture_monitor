## host_panel/src/main/Kconfig.projbuild
```kconfig
menu "Aquaculture monitor panel project config"

    menu "SEU-WLAN Connection Configuration"
        config ENABLE_SEU_WLAN
            bool "Enable SEU-WLAN auto login"
            default n
            help
                This option enables the SEU-WLAN auto login feature. If you enable this option, you should also set the SEU Login Username and SEU Login Password.
        
        if ENABLE_SEU_WLAN
            config SEU_LOGIN_USERNAME
                string "SEU login username"
                default "username"
                help
                    This is the username you use to login to the SEU-WLAN network.
    
            config SEU_LOGIN_PASSWORD
                string "SEU login password"
                default "password"
                help
                    This is the password you use to login to the SEU-WLAN network.
        endif
    endmenu

    menu "Upload Server Configuration"
        config SERVER_NAME
            string "Upload server name"
            default "rabbyte.xyz"
            help
                This is the upload server you send data to.
        
        config SERVER_PORT
            string "Upload server port"
            default "443"
            help
                This is the upload server port you send data to.
        
        config SERVER_URL
            string "Upload url"
            default "https://rabbyte.xyz/aquaculture_logger.php?time=%s&ind=%d&tds=%f&ph=%f&nth=%f&water_depth=%f&water_temperature=%f"
            help
                This is the url you send data to.
        
        config DATA_URL
            string "Download data url"
            default "https://rabbyte.xyz/aquaculture_data.csv"
            help
                This is where you get data from.
    endmenu

    menu "Camera Image Transfer Configuration"
        config ONE_SINGLE_PACKAGE_SIZE
            int "Single package size"
            default 240
            range 16 249
            help
                This is how large a single image package is.
        
        config CAMERA_IMAGE_WIDTH
            int "Photo width"
            default 352
            range 150 480
            help
                This is the width of the photo.

        config CAMERA_IMAGE_HEIGHT
            int "Photo height"
            default 288
            range 150 480
            help
                This is the height of the photo.
    endmenu
    
    config MAX_DEVICE
        int "Max device numbers can be connected"
        default 10
        range 0 20
        help
            This is how many device you can connect to.
endmenu
```

## slave_hub/main/Kconfig.projbuild
```kconfig
menu "Slave hub project config"
    config USE_FLASHLIGHT
        bool "Use flashlight"
        default n
        help
            This is to enable the flashlight feature.

    config ONE_SINGLE_PACKAGE_SIZE
        int "Single package size"
        default 240
        range 16 249
        help
            This is how large a single image package is.
    
    config ARDUINO_SLAVE_ADDR
        int "Arduino slave address"
        default 8
        range 0 127
        help
            This is the address of the slave Arduino.

    config DATA_UPDATE_PERIOD_MS
        int "Data update period"
        default 5000
        range 500 100000
        help
            This is the period of updating data in ms.
    
    config IMAGE_DELAY_PERIOD_MS
        int "Image delay period"
        default 50
        range 10 1000
        help
            This is the period of displaying an image in ms.

    config USE_MASTER_MAC
        bool "Use master MAC"
        default n
        help
            This is to enable the master MAC feature, else will broadcast the data.
    
    if USE_MASTER_MAC
        config MASTER_MAC_ADDR 
            string "Master MAC address"
            default "3f:3f:3f:3f:3f:3f"
            help
                This is the MAC address of the master.
    endif
    
    menu "IIC IO config"
        config I2C_MASTER_SCL_IO
            int "I2C master SCL IO"
            default 12
            range 0 39
            help
                This is the SCL IO of the master.
        
        config I2C_MASTER_SDA_IO
            int "I2C master SDA IO"
            default 13
            range 0 39
            help
                This is the SDA IO of the master.

    endmenu
endmenu
```
